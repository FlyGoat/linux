## Documentation/devicetree/bindings/clock/img,boston-clock.yaml
```yaml
# SPDX-License-Identifier: (GPL-2.0-only OR BSD-2-Clause)
%YAML 1.2
---
$id: http://devicetree.org/schemas/clock/imx5-clock.yaml#
$schema: http://devicetree.org/meta-schemas/core.yaml#

title: Imagination Technologies Boston Clock Controller

maintainers:
  - Jiaxun Yang <jiaxun.yang@flygoat.com>

description: Boston Clock Controller is a clock controller for Imagination
  Technologies Boston devlopment platform.
  The clock consumer should specify the desired clock by having the clock
  ID in its "clocks" phandle cell.
  See include/dt-bindings/clock/boston-clock.h for the full list of boston
  clock IDs.

properties:
  compatible:
    const: img,boston-clock

  "#clock-cells":
    const: 1

  img,platform-regs:
    $ref: /schemas/types.yaml#/definitions/phandle
    description:
      Phandle to the syscon managing the "general register files" (GRF),

required:
  - "#clock-cells"
  - compatible
```

## Documentation/devicetree/bindings/interrupt-controller/loongson,ipi.yaml
```yaml
# SPDX-License-Identifier: (GPL-2.0-only OR BSD-2-Clause)
%YAML 1.2
---
$id: http://devicetree.org/schemas/interrupt-controller/loongson,ipi.yaml#
$schema: http://devicetree.org/meta-schemas/core.yaml#

title: Loongson Inter-Processor Interrupt (IPI) Controller

maintainers:
  - Jiaxun Yang <jiaxun.yang@flygoat.com>

properties:
  compatible:
    oneOf:
      - const: loongson,ls2k-ipi
      - const: loongson,ls3a-ipi
      - const: loongson,csr-ipi
      - items:
          - const: loongson,ls3a-ipi
          - const: loongson,csr-ipi

  reg:
    minItems: 1
    maxItems: 16
    description: Specifies MMIO registers for each node of the IPI controller.
      Optional for the CSR-based IPI controller.

  interrupts-extended:
    minItems: 1
    maxItems: 4095

allOf:
  - if:
      properties:
        compatible:
          contains:
            const: loongson,ls2k-ipi
    then:
      properties:
        reg:
          maxItems: 1

  - if:
      not:
        properties:
          compatible:
            contains:
              const: loongson,csr-ipi
    then:
      required:
        - reg

required:
  - compatible
  - interrupts-extended

additionalProperties: false

examples:
  # Loongson-2K IPI controller
  - |
      cpuintc: interrupt-controller {
        #address-cells = <0>;
        #interrupt-cells = <1>;
        interrupt-controller;
        compatible = "mti,cpu-interrupt-controller";
      };

      ipi@3ff01000 {
        compatible = "loongson,ls2k-ipi";
        interrupts-extended = <&cpuintc 6>;
        reg = <0x1fe01000 0x1000>;
      };
  
  # Loongson-2K IPI controller with percpu cpuintc 
  - |
    / {
      	cpus {
          #address-cells = <1>;
          #size-cells = <0>;

          cpu0: cpu@0 {
            device_type = "cpu";
            compatible = "loongson,gs264";
            reg = <0x0>;
            cpu0intc: interrupt-controller {
              #address-cells = <0>;
              #interrupt-cells = <1>;
              interrupt-controller;
              compatible = "mti,cpu-interrupt-controller";
            };
          };

          cpu1: cpu@1 {
            device_type = "cpu";
            compatible = "loongson,gs264";
            reg = <0x1>;
            cpu1intc: interrupt-controller {
              #address-cells = <0>;
              #interrupt-cells = <1>;
              interrupt-controller;
              compatible = "mti,cpu-interrupt-controller";
            };
          };
        };

        ipi@3ff01000 {
          compatible = "loongson,ls2k-ipi";
          interrupts-extended = <&cpu0intc 6>, <&cpu1intc 6>;
          reg = <0x1fe01000 0x1000>;
        };
    };

  # 4 nodes Loongson-3A MMIO IPI controller
  - |
    / {
      #address-cells = <2>;
      #size-cells = <2>;

      ipi@3ff01000 {
        compatible = "loongson,ls3a-ipi";
        interrupts-extended = <&cpuintc 6>;
        reg = <0x0000000 0x3ff01000 0 0x1000>,
              <0x0001000 0x3ff01000 0 0x1000>,
              <0x0002000 0x3ff01000 0 0x1000>,
              <0x0003000 0x3ff01000 0 0x1000>;
      };
    };
  
  # 4 nodes Loongson-3A MMIO + CSR controller
  - |
    / {
      #address-cells = <2>;
      #size-cells = <2>;

      ipi@3ff01000 {
        compatible = "loongson,ls3a-ipi", "loongson,csr-ipi";
        interrupts-extended = <&cpuintc 6>;
        reg = <0x0000000 0x3ff01000 0 0x1000>,
              <0x0001000 0x3ff01000 0 0x1000>,
              <0x0002000 0x3ff01000 0 0x1000>,
              <0x0003000 0x3ff01000 0 0x1000>;
      };
    };

  # CSR only IPI controller
  - |
    / {
      #address-cells = <2>;
      #size-cells = <2>;

      ipi {
        compatible = "loongson,csr-ipi";
        interrupts-extended = <&cpuintc 6>;
      };
    };
```

## Documentation/devicetree/bindings/mfd/img,boston-platform-regs.yaml
```yaml
# SPDX-License-Identifier: (GPL-2.0-only OR BSD-2-Clause)
%YAML 1.2
---
$id: http://devicetree.org/schemas/mfd/img,boston-platform-regs.yaml#
$schema: http://devicetree.org/meta-schemas/core.yaml#

title: Imagination Technologies Boston Platform Registers

maintainers:
  - Jiaxun Yang <jiaxun.yang@flygoat.com>

properties:
  compatible:
    items:
      - const: img,boston-platform-regs
      - const: syscon
      - const: simple-mfd

  reg:
    maxItems: 1

  clock:
    type: object

    description: Boston Clock Controller Device Node
      The clock consumer should specify the desired clock by having the clock
      ID in its "clocks" phandle cell.
      See include/dt-bindings/clock/boston-clock.h for the full list of boston
      clock IDs.

    properties:
      "#clock-cells":
        const: 1

      compatible:
        const: img,boston-clock

    required:
      - "#clock-cells"
      - compatible

    additionalProperties: false

  syscon-reboot:
    $ref: /schemas/power/reset/syscon-reboot.yaml#

required:
  - compatible
  - reg
  - clock
  - syscon-reboot

additionalProperties: false

examples:
  - |
    #include <dt-bindings/clock/boston-clock.h>

    plat_regs: system-controller@17ffd000 {
      compatible = "img,boston-platform-regs", "syscon", "simple-mfd";
      reg = <0x17ffd000 0x1000>;

      clk_boston: clock {
        compatible = "img,boston-clock";
        #clock-cells = <1>;
      };

      reboot: syscon-reboot {
        compatible = "syscon-reboot";
        regmap = <&plat_regs>;
        offset = <0x10>;
        mask = <0x10>;
      };
    };
```

## Documentation/devicetree/bindings/mips/img/devices.yaml
```yaml
# SPDX-License-Identifier: (GPL-2.0-only OR BSD-2-Clause)
%YAML 1.2
---
$id: http://devicetree.org/schemas/mips/img/devices.yaml#
$schema: http://devicetree.org/meta-schemas/core.yaml#

title: Imagination Technologies MIPS based Platforms

maintainers:
  - Jiaxun Yang <jiaxun.yang@flygoat.com>

properties:
  $nodename:
    const: '/'
  compatible:
    oneOf:

      - description: IMG Boston
        const: img,boston

      - description: IMG Marduk (Creator Ci40)
        items:
          - const: img,pistachio-marduk
          - const: img,pistachio

      - description: Imagination University Program MIPSfpga
        items:
          - const: img,xilfpga
          - const: digilent,nexys4ddr

additionalProperties: true

...
```

## Documentation/devicetree/bindings/mips/mti,mips-cm.yaml
```yaml
# SPDX-License-Identifier: (GPL-2.0-only OR BSD-2-Clause)
%YAML 1.2
---
$id: http://devicetree.org/schemas/mips/mti,mips-cm.yaml#
$schema: http://devicetree.org/meta-schemas/core.yaml#

title: MIPS Coherence Manager

description: |
  Defines a location of the MIPS Coherence Manager registers.

maintainers:
  - Jiaxun Yang <jiaxun.yang@flygoat.com>

properties:
  compatible:
    const: mti,mips-cm

  reg:
    description:
      Base address and size of an unoccupied region in system's MMIO address
      space, which will be used to map the MIPS CM global control registers
      block. It is conventionally decided by the system integrator.
    maxItems: 1

required:
  - compatible
  - reg

additionalProperties: false

examples:
  - |
    coherency-manager@1fbf8000 {
      compatible = "mti,mips-cm";
      reg = <0x1bde8000 0x8000>;
    };
...
```
