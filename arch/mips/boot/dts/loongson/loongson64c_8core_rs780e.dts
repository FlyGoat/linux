// SPDX-License-Identifier: GPL-2.0

/dts-v1/;

#include "loongson64c-package.dtsi"
#include "rs780e-pch.dtsi"

/ {
	compatible = "loongson,loongson64c-8core-rs780e";
};

&ipi {
	reg = <0x0000000 0x3ff01000 0 0x1000>,
	      <0x0001000 0x3ff05000 0 0x1000>,
	      <0x0002000 0x3ff09000 0 0x1000>,
	      <0x0003000 0x3ff0d000 0 0x1000>;
};

&package0 {
	htpic: interrupt-controller@1efdfb000080 {
		compatible = "loongson,htpic-1.0";
		reg = <0x1efd 0xfb000080 0x40>;
		interrupt-controller;
		#interrupt-cells = <1>;

		interrupt-parent = <&liointc>;
		interrupts = <24 IRQ_TYPE_LEVEL_HIGH>,
				<25 IRQ_TYPE_LEVEL_HIGH>,
				<26 IRQ_TYPE_LEVEL_HIGH>,
				<27 IRQ_TYPE_LEVEL_HIGH>;
	};
};
